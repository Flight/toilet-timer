## main/Kconfig.projbuild
```kconfig
menu "TOILET TIMER BOARD SETTINGS (Waveshare ESP32-S3-ePaper-1.54)"
  config ENV_GPIO_RANGE_MIN
    int
    default 0

  config ENV_GPIO_RANGE_MAX
    int
    default 48

  config BUTTON_PWR_GPIO
    int "PWR key GPIO number"
    range ENV_GPIO_RANGE_MIN ENV_GPIO_RANGE_MAX
    default 18
    help
      GPIO number (IOxx) of the PWR key (active LOW). A short press of either
      key marks a litter change and resets the counter to "today"; holding a
      key forces a Wi-Fi time sync and OTA check instead. Must be an RTC GPIO
      (0-21) so it can wake the chip from deep sleep.

  config BUTTON_BOOT_GPIO
    int "BOOT key GPIO number"
    range ENV_GPIO_RANGE_MIN ENV_GPIO_RANGE_MAX
    default 0
    help
      GPIO number (IOxx) of the BOOT key (active LOW). Same function as the
      PWR key.

  config BUTTON_LONG_PRESS_MS
    int "Long press threshold in ms after boot"
    range 300 10000
    default 1500
    help
      A key still held this many milliseconds after the wake-up boot counts as
      a long press (the boot itself takes about a second, so this is roughly a
      2.5 s hold). A long press triggers the Wi-Fi sync and OTA check without
      resetting the counter.

  config LED_FEEDBACK_ENABLED
    bool "Blink the green LED as feedback"
    default y
    help
      Slow blinks for 5 s when a litter change is recorded, one long blink
      when a sync is requested, fast blinks for 10 s when the battery is low.
      The LED draws about 0.1 mA while lit and is released before deep sleep.
      (The red LED is the charger's own status indicator and cannot be
      controlled by the firmware.)

  config LED_GREEN_GPIO
    int "Green LED GPIO number (active LOW)"
    range ENV_GPIO_RANGE_MIN ENV_GPIO_RANGE_MAX
    default 3
    depends on LED_FEEDBACK_ENABLED

  config BOARD_POWER_LATCH_GPIO
    int "Battery power latch GPIO number (BAT_Control)"
    range ENV_GPIO_RANGE_MIN ENV_GPIO_RANGE_MAX
    default 17
    help
      When the board runs from the lithium battery, this pin must be driven HIGH
      to keep the 3.3V rail enabled after the PWR key is released, and it is held
      HIGH through deep sleep. Driving it LOW switches the board off completely.

  config BOARD_POWER_LATCH_WEAK
    bool "Hold the battery latch with the internal pull-up (saves ~2.5 mA)"
    default y
    help
      BAT_Control drives the base of the latch transistor through a 1 kOhm
      resistor (R64), so a GPIO driven HIGH sinks about 2.6 mA for as long as
      the board is on - deep sleep included. That is by far the biggest
      consumer on the board (about 70 mAh per day, one week on a 500 mAh
      cell).

      With this option the pin becomes an input with the ESP32's internal
      pull-up (about 45 kOhm) once the firmware runs, biasing the transistor
      with roughly 60 uA instead. Whether that is enough depends on the
      tolerances of the transistor and of the pull-up, so the firmware
      protects itself: it records in NVS when it runs or sleeps on the weak
      latch, and if the next boot is a power-on reset (the board switched
      itself off) it falls back to driving the pin HIGH for good. A power
      loss while the battery was almost empty is not counted as a failure.

      The fix that always works is a hardware change: replace R64 (1 kOhm,
      next to the PWR key) with 10-22 kOhm and disable this option.

  config BOARD_POWER_LATCH_WEAK_TRIAL_ID
    int "Weak latch trial number"
    range 1 255
    default 1
    depends on BOARD_POWER_LATCH_WEAK
    help
      The verdict (confirmed / failed) is stored in NVS together with this
      number. Change it to make the firmware forget a "failed" verdict and
      try the weak latch again, for example after a wrong verdict caused by
      an empty battery.

  config MAX_AWAKE_SECONDS
    int "Force deep sleep after this many seconds awake"
    range 60 3600
    default 300
    help
      Safety net: if anything hangs (display timeout, Wi-Fi that never
      connects, a stuck task) the device goes to deep sleep anyway instead of
      staying awake until the battery is flat. A running OTA download is
      granted the same time once more.

  config BOARD_AUDIO_POWER_GPIO
    int "Audio codec power enable GPIO number (active LOW)"
    range ENV_GPIO_RANGE_MIN ENV_GPIO_RANGE_MAX
    default 42
    help
      Supply switch (PA_EN) of the ES8311 codec and the speaker amplifier.
      The pin state is held through deep sleep.

  config BOARD_AUDIO_POWER_KEEP_ON
    bool "Keep the audio codec powered while awake"
    default y
    help
      The ES8311 codec shares the I2C bus with the RTC and the SHTC3 sensor.
      When its supply is switched off, its input protection diodes clamp SDA
      and SCL low: the RTC and the sensor stop responding. Keeping the codec
      powered while awake costs only its standby current.

      The rail is always switched off for deep sleep, where nobody uses the
      bus: with the load switch on, its 10 kOhm gate pull-up alone wastes
      0.33 mA. The speaker amplifier (PA_CTRL) stays disabled either way.

  config BOARD_I2C_SDA_GPIO
    int "I2C SDA GPIO number (RTC, SHTC3, codec)"
    range ENV_GPIO_RANGE_MIN ENV_GPIO_RANGE_MAX
    default 47

  config BOARD_I2C_SCL_GPIO
    int "I2C SCL GPIO number (RTC, SHTC3, codec)"
    range ENV_GPIO_RANGE_MIN ENV_GPIO_RANGE_MAX
    default 48

  config SHTC3_ENABLED
    bool "Show temperature and humidity from the onboard SHTC3 sensor"
    default y
    help
      Reads the SHTC3 once per wake-up (a few milliseconds, the sensor sleeps
      in between) and shows the values in the status bar.

  config IS_BATTERY_LEVEL_ENABLED
    bool "Enable battery level"
    default y
    help
      Measure the battery voltage once per wake-up and show the charge level
      in the status bar.

  config BATTERY_LEVEL_GPIO
    int "Battery level GPIO number"
    range ENV_GPIO_RANGE_MIN ENV_GPIO_RANGE_MAX
    default 4
    depends on IS_BATTERY_LEVEL_ENABLED
    help
      GPIO number (IOxx) of the battery voltage divider (BAT_ADC). On the
      Waveshare board GPIO4 (ADC1 channel 3) sees VBAT / 2.

  config BATTERY_FULL_MV
    int "Measured battery voltage that counts as 100 % (mV)"
    range 3600 4400
    default 4060
    depends on IS_BATTERY_LEVEL_ENABLED
    help
      Calibration point: the voltage this firmware measures on a fully charged
      battery (the on-board divider and ADC read a little low). 3300 mV is
      always 0 %; the lithium discharge curve is stretched between the two.

  config BATTERY_LOG_ENABLED
    bool "Keep a battery voltage history in NVS"
    default y
    depends on IS_BATTERY_LEVEL_ENABLED
    help
      Stores the battery voltage of every wake-up, with its cause and the
      latch mode, in a ring buffer in NVS and prints the history at boot.
      Lets you measure the real drain over days without a multimeter.

  config BATTERY_LOG_ENTRIES
    int "Number of wake-ups kept in the history"
    range 8 128
    default 48
    depends on BATTERY_LOG_ENABLED

  config BATTERY_LOW_PERCENT
    int "Low battery warning threshold (%)"
    range 1 90
    default 20
    depends on IS_BATTERY_LEVEL_ENABLED
    help
      At or below this level the green LED blinks fast for 10 s on every
      wake-up and a large battery icon is shown at the bottom of the screen.
endmenu

menu "TOILET TIMER E-PAPER DISPLAY SETTINGS"
  config EPD_PIN_MOSI
    int "E-Paper MOSI GPIO number"
    range ENV_GPIO_RANGE_MIN ENV_GPIO_RANGE_MAX
    default 13
    help
      GPIO number (IOxx) for the E-Paper display MOSI (SDI) pin.

  config EPD_PIN_CLK
    int "E-Paper CLK GPIO number"
    range ENV_GPIO_RANGE_MIN ENV_GPIO_RANGE_MAX
    default 12
    help
      GPIO number (IOxx) for the E-Paper display SCLK pin.

  config EPD_PIN_CS
    int "E-Paper CS GPIO number"
    range ENV_GPIO_RANGE_MIN ENV_GPIO_RANGE_MAX
    default 11
    help
      GPIO number (IOxx) for the E-Paper display CS pin.

  config EPD_PIN_DC
    int "E-Paper DC GPIO number"
    range ENV_GPIO_RANGE_MIN ENV_GPIO_RANGE_MAX
    default 10
    help
      GPIO number (IOxx) for the E-Paper display D/C pin.

  config EPD_PIN_RST
    int "E-Paper RST GPIO number"
    range ENV_GPIO_RANGE_MIN ENV_GPIO_RANGE_MAX
    default 9
    help
      GPIO number (IOxx) for the E-Paper display RST pin.

  config EPD_PIN_BUSY
    int "E-Paper BUSY GPIO number"
    range ENV_GPIO_RANGE_MIN ENV_GPIO_RANGE_MAX
    default 8
    help
      GPIO number (IOxx) for the E-Paper display BUSY pin (HIGH while busy).

  config EPD_PIN_POWER
    int "E-Paper POWER GPIO number"
    range ENV_GPIO_RANGE_MIN ENV_GPIO_RANGE_MAX
    default 6
    help
      GPIO number (IOxx) of the E-Paper supply switch (EPD3V3_EN).

  config EPD_POWER_ACTIVE_LOW
    bool "E-Paper POWER pin is active LOW"
    default y
    help
      On the Waveshare board EPD3V3_EN drives a P-channel MOSFET: LOW powers the
      panel, HIGH switches it off.

  config DISPLAY_WIDTH
    int "Display width in pixels"
    default 200
    help
      Physical width of the E-Paper display in pixels.

  config DISPLAY_HEIGHT
    int "Display height in pixels"
    default 200
    help
      Physical height of the E-Paper display in pixels.

  choice DISPLAY_ROTATION_CHOICE
    prompt "Display rotation"
    default DISPLAY_ROTATION_0
    help
      Rotation of the rendered image relative to the panel's native orientation.
      Change it if the text appears sideways or upside down in your enclosure.

    config DISPLAY_ROTATION_0
      bool "0 degrees"
    config DISPLAY_ROTATION_90
      bool "90 degrees clockwise"
    config DISPLAY_ROTATION_180
      bool "180 degrees"
    config DISPLAY_ROTATION_270
      bool "270 degrees clockwise"
  endchoice

  config DISPLAY_ROTATION
    int
    default 0 if DISPLAY_ROTATION_0
    default 90 if DISPLAY_ROTATION_90
    default 180 if DISPLAY_ROTATION_180
    default 270 if DISPLAY_ROTATION_270

  config SCREEN_DEMO
    bool "Test only: cycle through every screen variant at boot"
    default n
    help
      Shows each message the device can display (today, yesterday, N days
      ago with every Ukrainian plural form, first-boot message, no-record
      screen) for a few seconds at every boot, then continues normally.
      Leave disabled for normal operation.

  config SCREEN_DEMO_HOLD_MS
    int "Milliseconds to hold each demo screen"
    default 5000
    depends on SCREEN_DEMO
endmenu

menu "TOILET TIMER RTC SETTINGS"
  config RTC_PCF85063_ENABLED
    bool "Use the onboard PCF85063 RTC chip"
    default y
    help
      Keep the time in the crystal-driven PCF85063 RTC instead of relying only on
      the ESP32's RC oscillator (which drifts about half an hour per day). The
      system time is restored from the RTC on every boot, written back after each
      SNTP sync, and the RTC alarm wakes the device for the nightly refresh.

  config RTC_INT_GPIO
    int "RTC interrupt (alarm) GPIO number"
    range ENV_GPIO_RANGE_MIN ENV_GPIO_RANGE_MAX
    default 5
    depends on RTC_PCF85063_ENABLED
    help
      Open-drain, active LOW alarm output of the PCF85063. Must be an RTC GPIO
      (0-21) so it can wake the chip from deep sleep.

  config RTC_ALARM_TEST_MINUTES
    int "Test only: fire the RTC alarm this many minutes after boot (0 = nightly alarm)"
    range 0 1440
    default 0
    depends on RTC_PCF85063_ENABLED
    help
      Debug aid to verify the alarm wake-up path without waiting for the
      night. Leave at 0 for normal operation.
endmenu

menu "TOILET TIMER WI-FI SETTINGS"
  config WIFI_SSID
    string "Wi-Fi SSID"
    default "wifi_network_name"
    help
        SSID (network name).

  config WIFI_PASSWORD
    string "Wi-Fi Password"
    default "wifi_password"
    help
      Wi-Fi password.

  config TIME_SYNC_INTERVAL_DAYS
    int "Days between automatic Wi-Fi time syncs"
    range 1 365
    default 30
    help
      Wi-Fi is expensive on battery, so the device connects only when needed:
      - always when the sync/update button (BOOT) is pressed,
      - on the very first boot, when the time is not known yet,
      - otherwise at most once per this many days (checked on every wake-up,
        including the nightly refresh), to correct the RTC drift and check
        for firmware updates.

      The PCF85063 RTC keeps the time between syncs to within a few seconds
      per month. Summer/winter time needs no sync at all: the RTC stores UTC
      and the POSIX timezone rule on the device applies the DST switch.
endmenu

menu "TOILET TIMER OTA UPDATE SETTINGS"
  config IS_ESP32_FIRMWARE_UPGRADE_ENABLED
    bool "Enable ESP32 firmware upgrade"
    default n
    help
      Enable ESP32 firmware upgrade.

  config ESP32_FIRMWARE_UPGRADE_URL
    string "ESP32 Firmware upgrade endpoint URL"
    depends on IS_ESP32_FIRMWARE_UPGRADE_ENABLED
    default "https://firmware.dongle-updater.com/toilet-timer.bin"
    help
      URL of server which hosts the ESP32 firmware image.
      Use http://127.0.0.1:5001/toilet-timer.bin for local testing.
endmenu

menu "TOILET TIMER SNTP TIME SETTINGS"
  config SNTP_TIME_SERVER
    string "SNTP server address"
    default "pool.ntp.org"
    help
      Hostname or IP address of the NTP server to sync time from.

  config SNTP_TIMEZONE
    string "Timezone (POSIX format)"
    default "CET-1CEST,M3.5.0,M10.5.0/3"
    help
      Timezone in POSIX format. Examples:
      - Amsterdam/Europe: CET-1CEST,M3.5.0,M10.5.0/3
      - Kyiv/Ukraine: EET-2EEST,M3.5.0/3,M10.5.0/4
      - London/UK: GMT0BST,M3.5.0/1,M10.5.0
      - New York/US Eastern: EST5EDT,M3.2.0,M11.1.0
      - Los Angeles/US Pacific: PST8PDT,M3.2.0,M11.1.0
      - UTC: UTC0
endmenu
```
